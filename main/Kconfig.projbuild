## main/Kconfig.projbuild
```kconfig
menu "Box Configuration"

    config BRIDGE_MOD_BOOT1
        int "MOD GPIO pin BOOT1"
        default 38

    config BRIDGE_MOD_RST1
        int "MOD GPIO pin RST1"
        default 39

    config BRIDGE_MOD_RX1
        int "GPIO pin for Rx1 signal"
        default 40

    config BRIDGE_MOD_TX1
        int "GPIO pin for Tx1 signal"
        default 41

    config BRIDGE_MOD_BOOT2
        int "MOD GPIO pin BOOT2"
        default 10

    config BRIDGE_MOD_RST2
        int "MOD GPIO pin RST2"
        default 11

    config BRIDGE_MOD_RX2
        int "GPIO pin for Rx2 signal"
        default 13

    config BRIDGE_MOD_TX2
        int "GPIO pin for Tx2 signal"
        default 12

    config BRIDGE_MOD_TDI
        int "MOD GPIO pin TDI"
        default 9

    config BRIDGE_MOD_TDO
        int "MOD GPIO pin TDO"
        default 14

    config BRIDGE_MOD_TCK
        int "MOD GPIO pin TCK"
        default 42
        
    config BRIDGE_MOD_TMS
        int "MOD GPIO pin TMS"
        default 21

    config BRIDGE_SDMMC_D1
        int "SDMMC DAT pin"
        default 9

    config BRIDGE_SDMMC_D0
        int "SDMMC DAT pin"
        default 14

    config BRIDGE_SDMMC_CMD
        int "SDMMC CMD pin"
        default 42

    config BRIDGE_SDMMC_CLK
        int "SDMMC CLK pin"
        default 21

    config BRIDGE_USB_VID
        hex "USB vendor ID"
        default 0x303A

    config BRIDGE_USB_PID
        hex "USB product ID"
        default 0x1002

    config BRIDGE_MANUFACTURER
        string "USB bridge manufacturer"
        default "Espressif Systems Co. Ltd."

    config BRIDGE_PRODUCT_NAME
        string "USB product name"
        default "Box Bridge"

    config BRIDGE_MSC_VOLUME_LABEL
        string "Volume label shown in the MSC disc"
        default "BOX_MSC"
        help
            Volume label shown in the MSC disc. Max lenght is 11 ASCII characters.

endmenu
```

## sdkconfig.defaults
```kconfig
CONFIG_USB_ENABLED=y
CONFIG_USB_CDC_ENABLED=y
CONFIG_USB_MSC_ENABLED=y
CONFIG_ESPTOOLPY_FLASHSIZE_4MB=y
CONFIG_ESP_TASK_WDT_CHECK_IDLE_TASK_CPU0=n
CONFIG_IDF_TARGET="esp32s3"
```

## sdkconfig.defaults.esp32s3
```kconfig
CONFIG_IDF_TARGET="esp32s3"
CONFIG_ESP32S3_DEFAULT_CPU_FREQ_240=y
CONFIG_ESP32S3_DEFAULT_CPU_FREQ_MHZ=240
CONFIG_ESP32S3_INSTRUCTION_CACHE_32KB=y
CONFIG_ESP32S3_DATA_CACHE_32KB=y
CONFIG_ESP_SYSTEM_RTC_FAST_MEM_AS_HEAP_DEPCHECK=n
CONFIG_ESP_SYSTEM_ALLOW_RTC_FAST_MEM_AS_HEAP=n
```
